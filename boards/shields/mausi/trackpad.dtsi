
&i2c1 {
	status: "okay";
    tps65: iqs5xx@74 {
        status = "okay";
        compatible = "azoteq,iqs5xx";
        reg = <0x74>;
        reset-gpios = <&gpio0 10 GPIO_ACTIVE_LOW | GPIO_PULL_UP>;
        rdy-gpios = <&gpio0 9 GPIO_ACTIVE_HIGH | GPIO_PULL_UP>;

        // Gesture features
        // one-finger-tap;
        // two-finger-tap;
        press-and-hold;
        press-and-hold-time = <250>;
        scroll; //two finger scroll
		schwachsinn;

        // Scroll direction
        // natural-scroll-y;
        // natural-scroll-x;

        // Sensitivity settings
        bottom-beta = <5>; //palm rejection
        stationary-threshold = <0>; //deadzone

        switch-xy;
        // flip-x;
        // flip-y;
    };
};
