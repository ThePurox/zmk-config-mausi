## boards/shields/mausi/Kconfig.defconfig
```kconfig
# Copyright (c) 2021 The ZMK Contributors
# SPDX-License-Identifier: MIT

if SHIELD_MAUSI

config ZMK_KEYBOARD_NAME
    default "Mausi"

config ZMK_POINTING
	default y

config I2C
	default y

config INPUT_AZOTEQ_IQS5XX
	default y

endif
```

## boards/shields/mausi/Kconfig.shield
```kconfig
# Copyright (c) 2021 The ZMK Contributors
# SPDX-License-Identifier: MIT

config SHIELD_MAUSI
    def_bool $(shields_list_contains,mausi)
```

## config/west.yml
```yaml
manifest:
  remotes:
    - name: zmkfirmware
      url-base: https://github.com/zmkfirmware
  projects:
    - name: zmk
      remote: zmkfirmware
      revision: main
      import: app/west.yml
    - name: zmk-driver-azoteq-iqs5xx
      remote: aym1607
      revision: main
  self:
    path: config
```
